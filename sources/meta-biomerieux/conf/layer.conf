## sources/meta-biomerieux/conf/layer.conf
```bitbake
# We have a conf and classes directory, add to BBPATH
BBPATH =. "${LAYERDIR}:"

# We have recipes-* directories, add to BBFILES
BBFILES += "${LAYERDIR}/recipes-*/*/*.bb \
            ${LAYERDIR}/recipes-*/*/*.bbappend"

BBFILE_COLLECTIONS += "meta-biomerieux"
BBFILE_PATTERN_meta-biomerieux = "^${LAYERDIR}/"
BBFILE_PRIORITY_meta-biomerieux = "99"

LAYERDEPENDS_meta-biomerieux = "core"
LAYERSERIES_COMPAT_meta-biomerieux = "honister"
```
